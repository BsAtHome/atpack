# ATtiny1616 device description
Architecture: AVR8X; Family: AVR TINY
Programming and debug interfaces: UPDI
Registers are 8-bit, read-write, no defined reset value unless marked. A register's access mark holds for its fields unless they carry their own. Offsets are from the block's base; lines under a group give offsets from that group; [hi:lo] are bit positions; {n}, {i} and the like mark numbered series; 'fields as' and 'values as' point back to an identical list; <NAME> marks a mode.

## Ordering variants
ATtiny1616-MFR: VQFN20, pinout QFN20, up to 20 MHz, -40 to 125 C, 1.8 to 5.5 V
ATtiny1616-MNR: VQFN20, pinout QFN20, up to 20 MHz, -40 to 105 C, 1.8 to 5.5 V
ATtiny1616-SFR: SOIC20, up to 20 MHz, -40 to 125 C, 1.8 to 5.5 V
ATtiny1616-SNR: SOIC20, up to 20 MHz, -40 to 105 C, 1.8 to 5.5 V

## Memory
data space: start 0x0000 size 0xC000, little endian
  0x00001400 EEPROM size 0x0100 eeprom, rw, page 0x20
  0x00001280 FUSES size 0xA fuses, rw, page 0x20
  0x3800 INTERNAL_SRAM size 0x0800 ram, rw
  0x00000000 IO size 0x1100 io, rw
  0x0000128A LOCKBITS size 0x1 lockbits, rw, page 0x20
  0x00008000 MAPPED_PROGMEM size 0x4000 other, ro, page 0x40
  0x00001103 PROD_SIGNATURES size 0x3D signatures, ro, page 0x40
  0x00001100 SIGNATURES size 0x3 signatures, ro, page 0x40
  0x00001300 USER_SIGNATURES size 0x20 user_signatures, rw, page 0x20
prog space: start 0x0000 size 0x4000, little endian
  0x00000000 PROGMEM size 0x4000 flash, rw, executable, page 0x40

## Peripheral instances (address, pins/pin function, parameters)
AC0 at 0x0680 (AC)
  pins: N0 PA6; N1 PB4; OUT0 PA5; P0 PA7; P1 PB5; P2 PB1; P3 PB6
AC1 at 0x0688 (AC)
  pins: N0 PA5; N1 PB7; OUT0 PB3; P0 PA7; P1 PA6; P2 PB0; P3 PB4
AC2 at 0x0690 (AC)
  pins: N0 PA7; N1 PB6; OUT0 PB2; P0 PA6; P1 PB0; P2 PB5; P3 PB7
ADC0 at 0x0600 (ADC)
  pins: AIN{n} PA{n}/AIN0 (n=0..7); AIN8 PB5/AIN0; AIN9 PB4/AIN0; AIN10 PB1/AIN0; AIN11 PB0/AIN0
ADC1 at 0x0640 (ADC)
  pins: AIN0 PA4/AIN1; AIN1 PA5/AIN1; AIN2 PA6/AIN1; AIN3 PA7/AIN1; AIN4 PB7/AIN1; AIN5 PB6/AIN1; AIN6 PC0/AIN1; AIN7 PC1/AIN1; AIN8 PC2/AIN1; AIN9 PC3/AIN1; AIN10 PC4/AIN1; AIN11 PC5/AIN1
BOD at 0x0080
CCL at 0x01C0
  pins: LUT0_IN0 PA0; LUT0_IN1 PA1; LUT0_IN2 PA2; LUT0_OUT0 PB4/CCL_ALT or PA4; LUT1_IN0 PC3; LUT1_IN1 PC4; LUT1_IN2 PC5; LUT1_OUT0 PC1/CCL_ALT or PA7
  pin routing set by: PORTMUX.CTRLA.LUT0, PORTMUX.CTRLA.LUT1
CLKCTRL at 0x0060
  pins: CLKI PA3; CLKO PB5; TOSC1 PB3; TOSC2 PB2
CPU at 0x0030
  pins: BREAK PC4/BREAK_ALT or PA1/BREAK
  pin routing set by: PORTMUX.CTRLA.EXTBRK
CPUINT at 0x0110
CRCSCAN at 0x0120
DAC0 at 0x06A0 (DAC)
  pins: OUT0 PA6
DAC1 at 0x06A8 (DAC)
DAC2 at 0x06B0 (DAC)
EVSYS at 0x0180
  pins: EVAPA{n} PA{n}/EVAINCH0 (n=0..7); EVAPB{n} PB{n}/EVAINCH1 (n=0..7); EVAPC0 PC0/EVAINCH2; EVAPC1 PC1/EVAINCH2; EVAPC2 PC2/EVAINCH2; EVAPC3 PC3/EVAINCH2; EVAPC4 PC4/EVAINCH2; EVAPC5 PC5/EVAINCH2; EVOUT0 PA2; EVOUT1 PB2; EVOUT2 PC2; EVSPA{n} PA{n}/EVSINCH0 (n=0..7); EVSPB{n} PB{n}/EVSINCH1 (n=0..7); EVSPC0 PC0/EVSINCH0; EVSPC1 PC1/EVSINCH0; EVSPC2 PC2/EVSINCH0; EVSPC3 PC3/EVSINCH0; EVSPC4 PC4/EVSINCH0; EVSPC5 PC5/EVSINCH0
  pin routing set by: EVSYS.ASYNCCH0.ASYNCCH0, EVSYS.ASYNCCH1.ASYNCCH1, EVSYS.ASYNCCH2.ASYNCCH2, PORTMUX.CTRLA.EVOUT0, PORTMUX.CTRLA.EVOUT1, PORTMUX.CTRLA.EVOUT2, EVSYS.SYNCCH0.SYNCCH0, EVSYS.SYNCCH1.SYNCCH1
FUSE at 0x1280
GPIO at 0x001C
LOCKBIT at 0x128A
NVMCTRL at 0x1000
PORTA at 0x0400 (PORT)
  pins: PIN{n} PA{n}/IOPORT (n=0..7)
PORTB at 0x0420 (PORT)
  pins: PIN{n} PB{n}/IOPORT (n=0..7)
PORTC at 0x0440 (PORT)
  pins: PIN0 PC0/IOPORT; PIN1 PC1/IOPORT; PIN2 PC2/IOPORT; PIN3 PC3/IOPORT; PIN4 PC4/IOPORT; PIN5 PC5/IOPORT
PORTMUX at 0x0200
PTC
  pins: DS0 PB2/PTC_DS; DS1 PB4/PTC_DS; X0 PA4/PTC_X; X1 PA5/PTC_X; X2 PA6/PTC_X; X3 PA7/PTC_X; X4 PB1/PTC_X; X5 PB0/PTC_X; X6 PC0/PTC_X; X7 PC1/PTC_X; X8 PC2/PTC_X; X9 PC3/PTC_X; X10 PC4/PTC_X; X11 PC5/PTC_X; X12 PB5/PTC_X; X13 PB4/PTC_X; Y0 PA4/PTC_Y; Y1 PA5/PTC_Y; Y2 PA6/PTC_Y; Y3 PA7/PTC_Y; Y4 PB1/PTC_Y; Y5 PB0/PTC_Y; Y6 PC0/PTC_Y; Y7 PC1/PTC_Y; Y8 PC2/PTC_Y; Y9 PC3/PTC_Y; Y10 PC4/PTC_Y; Y11 PC5/PTC_Y; Y12 PB5/PTC_Y; Y13 PB4/PTC_Y
RSTCTRL at 0x0040
  pins: RESET PA0/OTHER
RTC at 0x0140
SIGROW at 0x1100
SLPCTRL at 0x0050
SPI0 at 0x0820 (SPI)
  pins: MISO PC1/SPI0_ALT or PA2; MOSI PC2/SPI0_ALT or PA1; SCK PC0/SPI0_ALT or PA3; SS PC3/SPI0_ALT or PA4
  pin routing set by: PORTMUX.CTRLB.SPI0
SYSCFG at 0x0F00
  pins: UPDI PA0/OTHER
TCA0 at 0x0A00 (TCA)
  pins: WO0 PB3/TCA0_ALT or PB0; WO1 PB4/TCA0_ALT or PB1; WO2 PB5/TCA0_ALT or PB2; WO3 PC3/TCA0_ALT or PA3; WO4 PC4/TCA0_ALT or PA4; WO5 PC5/TCA0_ALT or PA5
  pin routing set by: PORTMUX.CTRLC.TCA00, PORTMUX.CTRLC.TCA01, PORTMUX.CTRLC.TCA02, PORTMUX.CTRLC.TCA03, PORTMUX.CTRLC.TCA04, PORTMUX.CTRLC.TCA05
TCB0 at 0x0A40 (TCB)
  pins: WO0 PC0/TCB0_ALT or PA5
  pin routing set by: PORTMUX.CTRLD.TCB0
TCB1 at 0x0A50 (TCB)
  pins: WO0 PC4/TCB1_ALT or PA3
  pin routing set by: PORTMUX.CTRLD.TCB1
TCD0 at 0x0A80 (TCD)
  pins: WOA PA4; WOB PA5; WOC PC0; WOD PC1
TWI0 at 0x0810 (TWI)
  pins: SCL PA2/TWI0_ALT or PB0; SDA PA1/TWI0_ALT or PB1
  pin routing set by: PORTMUX.CTRLB.TWI0
USART0 at 0x0800 (USART)
  pins: RXD PA2/USART0_ALT or PB3; TXD PA1/USART0_ALT or PB2; XCK PA3/USART0_ALT or PB1; XDIR PA4/USART0_ALT or PB0
  pin routing set by: PORTMUX.CTRLB.USART0
USERROW at 0x1300
VPORTA at 0x0000 (VPORT)
VPORTB at 0x0004 (VPORT)
VPORTC at 0x0008 (VPORT)
VREF at 0x00A0
WDT at 0x0100

## Interrupts
1 NMI (CRCSCAN)
2 VLM (BOD)
3 PORT (PORTA)
4 PORT (PORTB)
5 PORT (PORTC)
6 CNT (RTC)
7 PIT (RTC)
8 LUNF (TCA0)
8 OVF (TCA0)
9 HUNF (TCA0)
10 LCMP0 (TCA0)
10 CMP0 (TCA0)
11 CMP1 (TCA0)
11 LCMP1 (TCA0)
12 CMP2 (TCA0)
12 LCMP2 (TCA0)
13 INT (TCB0)
14 INT (TCB1)
15 OVF (TCD0)
16 TRIG (TCD0)
17 AC (AC0)
18 AC (AC1)
19 AC (AC2)
20 RESRDY (ADC0)
21 WCOMP (ADC0)
22 RESRDY (ADC1)
23 WCOMP (ADC1)
24 TWIS (TWI0)
25 TWIM (TWI0)
26 INT (SPI0)
27 RXC (USART0)
28 DRE (USART0)
29 TXC (USART0)
30 EE (NVMCTRL)

## Properties
OCD_FEATURES: BREAK_PIN=PA1, BREAK_PIN_ALT=PC4
SIGNATURES: SIGNATURE0=0x1E, SIGNATURE1=0x94, SIGNATURE2=0x21

## Pinouts (pin number, pad)
QFN20: 1 PA2, 2 PA3, 3 GND, 4 VDD, 5 PA4, 6 PA5, 7 PA6, 8 PA7, 9 PB5, 10 PB4, 11 PB3, 12 PB2, 13 PB1, 14 PB0, 15 PC0, 16 PC1, 17 PC2, 18 PC3, 19 PA0, 20 PA1
SOIC20: 1 VDD, 2 PA4, 3 PA5, 4 PA6, 5 PA7, 6 PB5, 7 PB4, 8 PB3, 9 PB2, 10 PB1, 11 PB0, 12 PC0, 13 PC1, 14 PC2, 15 PC3, 16 PA0, 17 PA1, 18 PA2, 19 PA3, 20 GND
