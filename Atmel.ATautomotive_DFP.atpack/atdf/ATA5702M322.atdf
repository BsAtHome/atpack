# ATA5702M322 device description
Architecture: AVR8; Family: megaAVR
Programming and debug interfaces: ISP, HVSP, debugWIRE
Registers are 8-bit, access not given, no defined reset value unless marked. A register's access mark holds for its fields unless they carry their own. Offsets are from the block's base; lines under a group give offsets from that group; [hi:lo] are bit positions; {n}, {i} and the like mark numbered series; 'fields as' and 'values as' point back to an identical list; <NAME> marks a mode.

## Ordering variants
standard: 2.1 to 4.2 V

## Memory
prog space: start 0x0000 size 0x10000, little endian
  0x0000 ROM size 0x8000 flash, ro, executable, page 0x40
  0x8000 FLASH size 0x8000 flash, rw, executable, page 0x40
signatures space: start 0 size 3, little endian
  0 SIGNATURES size 3 signatures, ro
fuses space: start 0 size 0x0001, little endian
  0 FUSES size 0x0001 fuses, rw
lockbits space: start 0 size 0x0001, little endian
  0 LOCKBITS size 0x0001 lockbits, rw
data space: start 0x0000 size 0x0600, little endian
  0x0000 REGISTERS size 0x0020 regs
  0x0020 MAPPED_IO size 0x01e0 io
  0x0200 IRAM size 0x0400 ram
eeprom space: start 0x0000 size 0x0880, little endian
  0x0000 EEPROM size 0x0880 eeprom, rw, page 0x10
io space: start 0x00 size 0x40, little endian

## Peripheral instances (address, pins/pin function, parameters)
AES at 0x00
CLK at 0x00
CPU at 0x00
CRC at 0x00
DEBOUNCE at 0x00
DEBUG at 0x00
DFIFO at 0x00
EEPROM at 0x00
FE at 0x00
GPIOREGS_DVCC at 0x00
GPIOREGS_LFVCC at 0x00
INT at 0x00
LED at 0x00
LF_FIFO at 0x00
LF_PROTOCOL_HANDLER at 0x00
LF_RECEIVER at 0x00
LF_RSSI at 0x00
LF_TIMER at 0x00
LF_TRANSPONDER at 0x00
MEM at 0x00
PORTB at 0x00
PORTC at 0x00
PORTD at 0x00
SFIFO at 0x00
SPI at 0x00
SPI2 at 0x00
SSM at 0x00
SUP at 0x00
TIMER0_WDT at 0x00
TIMER1 at 0x00
TIMER2 at 0x00
TIMER3 at 0x00
TIMER4 at 0x00
TIMER5 at 0x00
TMO at 0x00
TPLF_CAL at 0x00
TWI1 at 0x00
TWI2 at 0x00
TXDSP at 0x00
TXM at 0x00
VX_MODE at 0x00
FUSE at 0 in fuses
LOCKBIT at 0 in lockbits

## Interrupts
0 RESET — External Pin, Power-on Reset, Brown-out Reset and Watchdog Reset
1 INT0 — External Interrupt Request 0
2 INT1 — External Interrupt Request 1
3 PCI0 — Pin Change Interrupt Request 0
4 PCI1 — Pin Change Interrupt Request 1
5 VMON — Voltage Monitoring Interrupt
6 AVCCR — AVCC Reset Interrupt
7 AVCCL — AVCC Low Interrupt
8 T0INT — Timer0 Interval Interrupt
9 T1COMP — Timer/Counter1 Compare Match Interrupt
10 T1OVF — Timer/Counter1 Overflow Interrupt
11 T2COMP — Timer/Counter2 Compare Match Interrupt
12 T2OVF — Timer/Counter2 Overflow Interrupt
13 T3CAP — Timer/Counter3 Capture Event Interrupt
14 T3COMP — Timer/Counter3 Compare Match Interrupt
15 T3OVF — Timer/Counter3 Overflow Interrupt
16 T4CAP — Timer/Counter4 Capture Event Interrupt
17 T4COMP — Timer/Counter4 Compare Match Interrupt
18 T4OVF — Timer/Counter4 Overflow Interrupt
19 T5COMP — Timer/Counter5 Compare Match Interrupt
20 T5OVF — Timer/Counter5 Overflow Interrupt
21 SPI — SPI Serial Transfer Complete Interrupt
22 SRX_FIFO — SPI Rx Buffer Interrupt
23 STX_FIFO — SPI Tx Buffer Interrupt
24 SSM — Sequencer State Machine Interrupt
25 DFFLR — Data FIFO fill level reached Interrupt
26 DFOUE — Data FIFO overflow or underflow error Interrupt
27 SFFLR — RSSI/Preamble FIFO fill level reached Interrupt
28 SFOUE — RSSI/Preamble FIFO overflow or underflow error Interrupt
29 TMTCF — Tx Modulator Telegram Finish Interrupt
30 AES — AES Krypto Unit Interrupt
31 TPINT — Transponder Mode Interrupt
32 TPTOERR — Transponder Timeout Error Interrupt
33 LFID0INT — LF receiver Identifier 0 Interrupt
34 LFID1INT — LF receiver Identifier 1 Interrupt
35 LFFEINT — LF receiver Frame End Interrupt
36 LFBCR — LF receiver Bit Count Reached Interrupt
37 LFPBD — LF receiver PreBurst Detected Interrupt
38 LFDE — LF receiver Decoder Error Interrupt
39 LFEOT — LF receiver End of Telegram Interrupt
40 LFTCOR — LF receiver Timer Compare Match Interrupt
41 LFRSCO — LF receiver RSSI measurement Interrupt
42 LDFFLR — LF Data FIFO Fill Level Reached Interrupt
43 LDFOUE — LF Data FIFO Overflow or Underflow Error Interrupt
44 EXCM — External input Clock monitoring Interrupt
45 E2CINT — EEPROM Error Correction Interrupt
46 ERDY — EEPROM Ready Interrupt
47 SPMR — Store Program Memory Ready
48 TWI1 — TWI1 Interrupt
49 SPI2 — SPI2 Interrupt
50 TWI2 — TWI2 Interrupt

## Properties
SIGNATURES: JTAGID=0x9569, SIGNATURE0=0x1e, SIGNATURE1=0x95, SIGNATURE2=0x69
OCD: OCD_REVISION=1, OCD_DATAREG=0x31, PROGBASE=0x0000
